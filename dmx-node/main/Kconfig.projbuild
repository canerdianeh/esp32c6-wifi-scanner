## dmx-node/main/Kconfig.projbuild
```kconfig
menu "DMX Node"

    comment "Board wiring. Show settings (modes, universes) are set at runtime over the web page or Bluetooth."
    comment "Pin defaults: ESP32-S3-DevKitC-1, ESP32-C6-DevKitC-1, ESP32-DevKitC (WROOM)."

    config NODE_NAME
        string "Node name prefix"
        default "DMX-Node"
        help
            Used for the setup access point, the Bluetooth name and the
            Art-Net short name, followed by the last 4 hex digits of the MAC,
            e.g. DMX-Node-8641. It can be renamed at runtime.

    config NODE_AP_PASSWORD
        string "Setup access point password (8-63 characters)"
        default "dmxsetup"
        help
            The node starts this access point when it has no Wi-Fi network
            configured, or can't join the one it has. The setup page is at
            http://192.168.4.1/.

    menu "Port A (DMX in or out)"

        config NODE_PORT_A_UART
            int "UART number"
            range 0 2
            default 1

        config NODE_PORT_A_TX_GPIO
            int "TX GPIO (to the RS485 transceiver's DI)"
            range 0 48
            default 0 if IDF_TARGET_ESP32C6
            default 17

        config NODE_PORT_A_RX_GPIO
            int "RX GPIO (from the RS485 transceiver's RO)"
            range 0 48
            default 1 if IDF_TARGET_ESP32C6
            default 16 if IDF_TARGET_ESP32
            default 18

        config NODE_PORT_A_DIR_GPIO
            int "Direction GPIO (to DE and /RE, high = transmit), -1 if none"
            range -1 48
            default 2 if IDF_TARGET_ESP32C6
            default 4 if IDF_TARGET_ESP32
            default 8
    endmenu

    menu "Port B (DMX out)"

        config NODE_PORT_B_UART
            int "UART number"
            range 0 2
            default 0 if IDF_TARGET_ESP32C6
            default 2
            help
                The ESP32-C6 has only UART0 and UART1, so port B uses UART0
                there (the log goes to the USB port instead).

        config NODE_PORT_B_TX_GPIO
            int "TX GPIO (to the RS485 transceiver's DI)"
            range 0 48
            default 3 if IDF_TARGET_ESP32C6
            default 25 if IDF_TARGET_ESP32
            default 15

        config NODE_PORT_B_DIR_GPIO
            int "Direction GPIO (to DE and /RE, high = transmit), -1 if none"
            range -1 48
            default 10 if IDF_TARGET_ESP32C6
            default 26 if IDF_TARGET_ESP32
            default 16
    endmenu

    menu "Pixel output (SPI)"

        config NODE_PIXEL_DATA_GPIO
            int "Data GPIO"
            range 0 48
            default 7 if IDF_TARGET_ESP32C6
            default 23 if IDF_TARGET_ESP32
            default 11

        config NODE_PIXEL_CLOCK_GPIO
            int "Clock GPIO (APA102 / SK9822 only), -1 if none"
            range -1 48
            default 6 if IDF_TARGET_ESP32C6
            default 18 if IDF_TARGET_ESP32
            default 12

        config NODE_PIXEL_MAX
            int "Maximum pixels"
            range 1 680
            default 680
            help
                680 RGB (or 512 RGBW) pixels fill four universes, the most
                one strip can use.
    endmenu

    menu "PWM output (LEDs or servos)"

        config NODE_PWM_GPIOS
            string "GPIOs, comma separated (up to 8)"
            default "18,19,20,21,22,23" if IDF_TARGET_ESP32C6
            default "32,33,27,14,13,21,22,19" if IDF_TARGET_ESP32
            default "4,5,6,7,1,2,42,41"
            help
                Channel 1 is the first GPIO. The ESP32-C6 has 6 PWM channels,
                so only the first 6 GPIOs are used there.

        config NODE_PWM_LED_FREQ_HZ
            int "LED PWM frequency (Hz)"
            range 100 40000
            default 19500
            help
                At 19.5 kHz the PWM has 12-bit resolution, which is above
                hearing range and shows no flicker on camera.
    endmenu

    config NODE_BLE_SETUP
        bool "Bluetooth LE setup"
        default y
        help
            A GATT service to read and change the settings from a phone.
            See README.md for the UUIDs and format.

    config NODE_BLE_SETUP_MINUTES
        int "Turn Bluetooth off after (minutes, 0 = never)"
        depends on NODE_BLE_SETUP
        range 0 1440
        default 5
        help
            While Bluetooth is on, Wi-Fi must share the radio and can't turn
            off power saving, which adds latency and dropped multicast
            frames. After this time (if nobody is connected) Bluetooth shuts
            down and Wi-Fi runs at full speed. Bluetooth stays on while no
            Wi-Fi network is configured.

endmenu
```

## ftm-responder/main/Kconfig.projbuild
```kconfig
menu "FTM Responder"

    config RESPONDER_SSID_PREFIX
        string "SSID prefix"
        default "OnePingOnly"
        help
            The SSID is this prefix, a dash, and the last 4 hex digits of the
            access point's MAC address, e.g. OnePingOnly-8641.

    config RESPONDER_PASSWORD
        string "Wi-Fi password (8-63 characters)"
        default "onepingonly"
        help
            FTM ranging doesn't need a connection, so nobody has to join this
            network. The password just keeps devices from joining it.

    config RESPONDER_CHANNEL
        int "Channel"
        range 1 13
        default 6

    config RESPONDER_FTM_OFFSET_CM
        int "FTM distance correction broadcast in the beacon (cm)"
        range -10000 10000
        default 0
        help
            Calibration for this responder's antenna and cable. It's sent in
            the beacon (see loc_ie.h) and the wearable scanner subtracts it
            from the distance it measures. Place the scanner at a known
            distance (e.g. 100 cm), note the *uncorrected* FTM distance in its
            log, and set this to (measured - actual) in cm: 195 cm measured at
            100 cm gives 95. An external antenna's cable adds roughly 1.5 cm
            per cm of cable.

            (ESP-IDF's own responder offset, esp_wifi_ftm_resp_set_offset,
            made no measurable difference in testing, so it isn't used.)

    choice RESPONDER_LED_TYPE
        prompt "Status LED"
        default RESPONDER_LED_WS2812
        help
            Running: slow heartbeat. Ranging: lit while FTM requests keep
            arriving, with a flash for each one.

        config RESPONDER_LED_WS2812
            bool "WS2812 RGB LED (green = running, cyan = ranging)"
        config RESPONDER_LED_SIMPLE
            bool "Single LED (blink = running, on = ranging)"
        config RESPONDER_LED_NONE
            bool "None"
    endchoice

    config RESPONDER_LED
        bool
        default y if RESPONDER_LED_WS2812 || RESPONDER_LED_SIMPLE

    config RESPONDER_LED_GPIO
        int "Status LED GPIO"
        depends on RESPONDER_LED
        range 0 30
        default 15 if RESPONDER_LED_SIMPLE
        default 8
        help
            WS2812: GPIO8 on ESP32-C6 DevKitC-1, DevKitM-1 and most C6 SuperMini
            boards. Single LED: GPIO15 on the Seeed XIAO ESP32-C6.

    config RESPONDER_LED_ACTIVE_LOW
        bool "LED lights when the pin is low"
        depends on RESPONDER_LED_SIMPLE
        default y
        help
            True for the Seeed XIAO ESP32-C6 user LED.

    choice RESPONDER_LED_ORDER
        prompt "Status LED byte order"
        depends on RESPONDER_LED_WS2812
        default RESPONDER_LED_ORDER_GRB
        help
            If green shows as red, choose RGB.

        config RESPONDER_LED_ORDER_GRB
            bool "GRB (most WS2812, Espressif DevKits)"
        config RESPONDER_LED_ORDER_RGB
            bool "RGB"
    endchoice

    config RESPONDER_LED_BRIGHTNESS
        int "Status LED brightness (1-255)"
        depends on RESPONDER_LED_WS2812
        range 1 255
        default 40

    choice RESPONDER_ANTENNA
        prompt "Antenna"
        default RESPONDER_ANTENNA_DEFAULT
        help
            Boards with an RF switch need firmware to pick the antenna.

        config RESPONDER_ANTENNA_DEFAULT
            bool "Board default (no RF switch to set)"
        config RESPONDER_ANTENNA_XIAO_INTERNAL
            bool "Seeed XIAO ESP32-C6: built-in ceramic antenna"
        config RESPONDER_ANTENNA_XIAO_EXTERNAL
            bool "Seeed XIAO ESP32-C6: external antenna (u.FL)"
    endchoice

    config RESPONDER_TX_POWER_DBM
        int "Maximum TX power (dBm)"
        range 2 20
        default 20

    menu "Location in beacon"

        config RESPONDER_LOC_FIXED
            bool "Fixed position"
            default n
            help
                Broadcast a fixed latitude/longitude in the beacon (used when
                there's no GPS fix).

        config RESPONDER_LAT
            string "Latitude (decimal degrees, + = north)"
            depends on RESPONDER_LOC_FIXED
            default "0.0"

        config RESPONDER_LON
            string "Longitude (decimal degrees, + = east)"
            depends on RESPONDER_LOC_FIXED
            default "0.0"

        config RESPONDER_ALT_M
            int "Altitude (m)"
            depends on RESPONDER_LOC_FIXED
            range -500 9000
            default 0

        config RESPONDER_ACCURACY_M
            int "Accuracy of the fixed position (m, 0 = unknown)"
            depends on RESPONDER_LOC_FIXED
            range 0 1000
            default 0

        config RESPONDER_CIVIC
            bool "Civic address (RFC 4776 / RFC 5580)"
            default n
            help
                Broadcast a civic address in the beacon, as RFC 4776 CAtype
                fields (the format RFC 5580 carries). Leave fields empty to omit
                them; values up to 40 characters.

        if RESPONDER_CIVIC
            config RESPONDER_CIVIC_COUNTRY
                string "Country code (ISO 3166, 2 letters)"
                default "US"
            config RESPONDER_CIVIC_A1
                string "State / province (CAtype 1)"
                default ""
            config RESPONDER_CIVIC_A3
                string "City (CAtype 3)"
                default ""
            config RESPONDER_CIVIC_RD
                string "Street name (CAtype 34)"
                default ""
            config RESPONDER_CIVIC_HNO
                string "House number (CAtype 19)"
                default ""
            config RESPONDER_CIVIC_PC
                string "Postal code (CAtype 24)"
                default ""
            config RESPONDER_CIVIC_BLD
                string "Building (CAtype 25)"
                default ""
            config RESPONDER_CIVIC_FLR
                string "Floor (CAtype 27)"
                default ""
            config RESPONDER_CIVIC_ROOM
                string "Room (CAtype 28)"
                default ""
            config RESPONDER_CIVIC_NAM
                string "Name, e.g. business (CAtype 23)"
                default ""
            config RESPONDER_CIVIC_LOC
                string "Additional location info (CAtype 22)"
                default ""
        endif

        config RESPONDER_GPS
            bool "GPS module on a UART (NMEA)"
            default n
            help
                With a fix, the live GPS position goes in the beacon (and
                overrides a fixed position). Detected automatically, including
                the baud rate.

        config RESPONDER_GPS_UART_NUM
            int "GPS UART number"
            depends on RESPONDER_GPS
            range 1 1
            default 1

        config RESPONDER_GPS_PIN_RX
            int "ESP RX GPIO (connect to the module's TX)"
            depends on RESPONDER_GPS
            default 17
            help
                GPIO17 is pin D7 on the Seeed XIAO ESP32-C6.

        config RESPONDER_GPS_PIN_TX
            int "ESP TX GPIO (module RX; -1 = not connected)"
            depends on RESPONDER_GPS
            range -1 30
            default 16
            help
                GPIO16 is pin D6 on the Seeed XIAO ESP32-C6.

        config RESPONDER_GPS_BAUD
            int "GPS baud rate (0 = detect)"
            depends on RESPONDER_GPS
            default 0

    endmenu

endmenu
```
